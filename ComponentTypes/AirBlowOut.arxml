AUTOSAR XML (schema 4-2-2)
package /ComponentTypes
  application sw component type AirBlowOut
    require port pwmBlowerSpeedOut: required-interface=AnalogueIO
    behavior AirBlowOut_InternalBehavior
  swc implementation AirBlowOut_Implementation: behavior=AirBlowOut_InternalBehavior
