AUTOSAR XML (schema 4-2-2)
package /ComponentTypes
  application sw component type Temp
    provide port temp: provided-interface=TempAnaloguePort
    behavior Temp_InternalBehavior
  swc implementation Temp_Implementation: behavior=Temp_InternalBehavior
