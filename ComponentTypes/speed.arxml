AUTOSAR XML (schema 4-2-2)
package /ComponentTypes
  application sw component type speed
    require port speed: nonqueued-receiver-com-spec{data-element=speed, init-value=0}, required-interface=speed
    behavior speed_InternalBehavior
  swc implementation speed_Implementation: behavior=speed_InternalBehavior
