AUTOSAR XML (schema 4-2-2)
package /ComponentTypes
  application sw component type Switch
    behavior Switch_InternalBehavior
  swc implementation Switch_Implementation: behavior=Switch_InternalBehavior
