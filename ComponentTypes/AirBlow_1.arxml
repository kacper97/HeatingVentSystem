AUTOSAR XML (schema 4-2-2)
package /ComponentTypes
  application sw component type AirBlow
    behavior AirBlow_InternalBehavior
  swc implementation AirBlow_Implementation: behavior=AirBlow_InternalBehavior
