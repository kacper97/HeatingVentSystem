AUTOSAR XML (schema 4-2-2)
package /ComponentTypes
  application sw component type CabinTempClosedLoop
    behavior CabinTempClosedLoop_InternalBehavior
  swc implementation CabinTempClosedLoop_Implementation: behavior=CabinTempClosedLoop_InternalBehavior
