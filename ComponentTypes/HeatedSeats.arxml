AUTOSAR XML (schema 4-2-2)
package /ComponentTypes
  application sw component type HeatedSeats
    behavior HeatedSeats_InternalBehavior
  swc implementation HeatedSeats_Implementation: behavior=HeatedSeats_InternalBehavior
