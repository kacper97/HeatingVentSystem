AUTOSAR XML (schema 4-2-2)
package /ComponentTypes
  application sw component type HeatedSeats
    provide port heatedSeatsOnOff: provided-interface=digitalIO
    behavior HeatedSeats_InternalBehavior
  swc implementation HeatedSeats_Implementation: behavior=HeatedSeats_InternalBehavior
