AUTOSAR XML (schema 4-2-2)
package /ComponentTypes
  application sw component type HeatedSeatsOut
    require port heatedSeatsOnOff: required-interface=digitalIO
    behavior HeatedSeatsOut_InternalBehavior
  swc implementation HeatedSeatsOut_Implementation: behavior=HeatedSeatsOut_InternalBehavior
