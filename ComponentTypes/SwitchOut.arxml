AUTOSAR XML (schema 4-2-2)
package /ComponentTypes
  application sw component type SwitchOut
    require port switchIn: required-interface=digitalIO
    behavior SwitchOut_InternalBehavior
  swc implementation SwitchOut_Implementation: behavior=SwitchOut_InternalBehavior
