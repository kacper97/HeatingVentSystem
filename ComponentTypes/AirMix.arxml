AUTOSAR XML (schema 4-2-2)
package /ComponentTypes
  application sw component type AirMix
    behavior AirMix_InternalBehavior
  swc implementation AirMix_Implementation: behavior=AirMix_InternalBehavior
