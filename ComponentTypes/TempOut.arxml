AUTOSAR XML (schema 4-2-2)
package /ComponentTypes
  application sw component type TempOut
    require port temp: required-interface=TempAnaloguePort
    behavior TempOut_InternalBehavior
  swc implementation TempOut_Implementation: behavior=TempOut_InternalBehavior
