AUTOSAR XML (schema 4-2-2)
package /ComponentTypes
  application sw component type AirMixIn
    provide port FlapSettingPercent: provided-interface=AnaloguePercent
    behavior AirMixIn_InternalBehavior
  swc implementation AirMixIn_Implementation: behavior=AirMixIn_InternalBehavior
