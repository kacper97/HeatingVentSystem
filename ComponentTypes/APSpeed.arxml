AUTOSAR XML (schema 4-2-2)
package /ComponentTypes
  application sw component type Speed
    require port speed: nonqueued-receiver-com-spec{data-element=speed, filter=data-filter-type=ALWAYS, init-value=0}, required-interface=speed
    behavior Speed_InternalBehavior
  swc implementation Speed_Implementation: behavior=Speed_InternalBehavior
