AUTOSAR XML (schema 4-2-2)
standard types defined: dtRef_const_VOID, dtRef_VOID, boolean, float32, float64, sint16, sint16_least, sint32, sint32_least, sint64, sint8, sint8_least, uint16, uint16_least, uint32, uint32_least, uint64, uint8, uint8_least, boolean_CompuMethod, boolean_DataConstr, float32_DataConstr, float64_DataConstr, sint16_DataConstr, sint16_least_DataConstr, sint32_DataConstr, sint32_least_DataConstr, sint64_DataConstr, sint8_DataConstr, sint8_least_DataConstr, uint16_DataConstr, uint16_least_DataConstr, uint32_DataConstr, uint32_least_DataConstr, uint64_DataConstr, uint8_DataConstr, uint8_least_DataConstr
package /ComponentTypes/DataTypeMappingSets
  data type mapping set speedMapSet: data-type-map{application-data-type=speed, implementation-data-type=sint16}
  data type mapping set tempMapSet: data-type-map{application-data-type=temperature, implementation-data-type=sint16}
  data type mapping set flapMapSet: data-type-map{application-data-type=flapSettingPercent, implementation-data-type=uint16}
package /Predefined_DEV/ImplementationDataTypes
  impl type NvM_RequestResultType: compu {0=NVM_REQ_OK, 1=NVM_REQ_NOT_OK, 2=NVM_REQ_PENDING, 3=NVM_REQ_INTEGRITY_FAILED, 4=NVM_REQ_BLOCK_SKIPPED, 5=NVM_REQ_NV_INVALIDATED, 6=NVM_REQ_CANCELED, 7=NVM_REQ_REDUNDANCY_FAILED, 8=NVM_REQ_RESTORED_FROM_ROM}, implementation-data-type=uint8
  impl type NvM_ServiceIdType: compu {6=NVM_READ_BLOCK, 7=NVM_WRITE_BLOCK, 8=NVM_RESTORE_BLOCK_DEFAULTS, 9=NVM_ERASE_BLOCK, 11=NVM_INVALIDATE_NV_BLOCK, 12=NVM_READ_ALL}, implementation-data-type=uint8
  impl type Dem_UdsStatusByteType: compu {mask 1: 1=DEM_UDS_STATUS_TF, mask 2: 2=DEM_UDS_STATUS_TFTOC, mask 4: 4=DEM_UDS_STATUS_PDTC, mask 8: 8=DEM_UDS_STATUS_CDTC, mask 16: 16=DEM_UDS_STATUS_TNCSLC, mask 32: 32=DEM_UDS_STATUS_TFSLC, mask 64: 64=DEM_UDS_STATUS_TNCTOC, mask 128: 128=DEM_UDS_STATUS_WIR}, range raw 0..255, implementation-data-type=uint8
package /DataTypes
  app type speed: category=VALUE, sw-calibration-access=READ-WRITE, range phys 0..220, unit=km/h
  app type temperature: category=VALUE, sw-calibration-access=READ-ONLY, range phys 16..28, unit=Celcius
  app type flapSettingPercent: category=VALUE, sw-calibration-access=READ-ONLY, range phys 0..100, raw 0..100, unit=f%
package /DataTypes/DataConstrs
  range tempOut: phys -70..70, raw -70..70
package /DataTypes/Units
  unit Kilometers: display-name=km/h
  unit Celcius
  unit flapPercent: display-name=f%
